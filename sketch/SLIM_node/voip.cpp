/*
  voip.cpp
  Phone calls between SLIM nodes over WiFi.  See voip.h.

  Threading:
    - loop() task (core 1): voipPoll() receives all UDP packets, runs call
      signaling, fills the playback jitter buffer, and sends audio generated by
      voicemail.  Mozzi's updateAudio() (also called from loop) empties the
      jitter buffer.  Because both happen in the same task it needs no locking.
    - capture task (core 0): woken 8192 times/sec by a hardware timer, reads
      the SLIC audio on GPIO32, filters it, decodes DTMF, u-law encodes it, and
      queues 160 sample frames.
    - sender task (core 0): sends the queued audio frames to the far end (or
      back to the loop task for the echo test and local recording).
*/

#include "voip.h"
#include "voip_config.h"
#include "project_globals.h"
#include "miscFunctions.h"        // nodeBusy()
#include "settings.h"             // WiFi, IP, number and directory
#include <WiFi.h>
#include <ESPmDNS.h>
#include <DNSServer.h>
#include <lwip/sockets.h>
#include <driver/adc.h>
#include <esp_system.h>
#include <freertos/FreeRTOS.h>
#include <freertos/task.h>
#include <freertos/queue.h>
#include <mozzi_config.h>         // AUDIO_RATE
#include <math.h>
#include "voip_dsp.h"

#if defined(ESP_ARDUINO_VERSION_MAJOR) && (ESP_ARDUINO_VERSION_MAJOR >= 3)
#error "This sketch needs the ESP32 Arduino core 1.0.6 - 2.0.x (Mozzi 1.1 and the legacy ADC/timer APIs). Select esp32 core version 2.0.17 in Boards Manager."
#endif


// ---------------------------------------------------------------------------
// audio format
// ---------------------------------------------------------------------------
#define VOIP_SAMPLE_RATE    8192                         // samples/sec sent over the network
#define VOIP_FRAME_SAMPLES  160                          // samples per packet (~19.5 mS)
#define VOIP_UPSAMPLE       (AUDIO_RATE / VOIP_SAMPLE_RATE)
#if (AUDIO_RATE % VOIP_SAMPLE_RATE) != 0
#error "Mozzi AUDIO_RATE must be a multiple of 8192"
#endif

#define MIC_ADC_CHANNEL     ADC1_CHANNEL_4               // GPIO32 = SLIC audio out (local phone mic)
#define SAMPLE_TIMER_NUM    3                            // hardware timer used for audio sampling
#define SAMPLE_TIMER_DIV    5                            // 80 MHz / 5 = 16 MHz timer clock
#define SAMPLE_TIMER_TICKS  1953                         // 16 MHz / 1953 = 8192.5 Hz

// ---------------------------------------------------------------------------
// signaling timing (mS)
// ---------------------------------------------------------------------------
#define INVITE_RESEND_MS        250      // resend call request until the far end answers it
#define INVITE_GIVEUP_MS        5000     // no reply at all -> number unreachable
#define RINGING_KEEPALIVE_MS    1000     // while ringing, keep telling the far end we're still here
#define CONNECTED_KEEPALIVE_MS  1000     // while connected, tell the far end we're still here
#define PEER_TIMEOUT_MS         5000     // far end silent this long -> call is dead
#define POLL_INTERVAL_US        2000     // how often loop() checks the network

// ---------------------------------------------------------------------------
// packet format
// ---------------------------------------------------------------------------
enum PacketType : uint8_t {
  PKT_INVITE = 1,      // caller -> callee: please ring your phone (resent while waiting)
  PKT_RINGING,         // callee -> caller: phone is ringing
  PKT_BUSY,            // callee -> caller: can't take the call
  PKT_ANSWER,          // callee -> caller: phone answered
  PKT_HANGUP,          // either way: call ended
  PKT_AUDIO,           // either way: u-law audio frame
  PKT_KEEPALIVE        // either way: still connected
};

struct __attribute__((packed)) PacketHeader {
  char     magic[2];   // 'S','L'
  uint8_t  version;
  uint8_t  type;
  uint32_t callId;     // random id chosen by the caller for each call
  uint16_t seq;        // audio frame sequence number
  uint16_t len;        // payload length
};

#define INV_TRUNK      0x01   // call uses the phone line, no audio packets
#define INV_BROADCAST  0x02   // sent to every node; only the one with the number answers

struct __attribute__((packed)) InvitePayload {
  char    from[16];    // caller's phone number
  char    to[16];      // number dialed
  uint8_t flags;
};

#define PROTOCOL_VERSION  2
#define MAX_PACKET        (sizeof(PacketHeader) + VOIP_FRAME_SAMPLES)

// ---------------------------------------------------------------------------
// call session state (owned by loop task)
// ---------------------------------------------------------------------------
enum SessionState { SS_IDLE, SS_OUT_INVITING, SS_OUT_RINGING, SS_IN_RINGING, SS_CONNECTED };

static SessionState  sess = SS_IDLE;
static uint32_t      sessCallId = 0;
static sockaddr_in   sessPeer;                 // far end address
static bool          sessPeerBroadcast = false;// still looking for the far end (phone line call)
static bool          sessTrunk = false;        // phone line call: relay carries the audio
static String        sessPeerNumber;
static String        sessDialedNumber;
static unsigned long sessStartMs = 0;
static unsigned long sessLastTxMs = 0;
static unsigned long sessLastRxMs = 0;
static uint16_t      sessLastRxSeq = 0;
static bool          sessGotAudio = false;
static VoipEvent     pendingEvent = VOIP_EV_NONE;

static int           sock = -1;                // signaling + audio receive (bound to VOIP_UDP_PORT)
static int           audioTxSock = -1;         // audio transmit (used only by sender task)
static unsigned long lastPollUs = 0;
static int           myEntry = -1;             // this node's line in the directory
static void          wifiStart();
static bool          apMode = false;           // couldn't join WiFi: running our own access point
static DNSServer*    dnsServer = NULL;         // access point: send every name to the config page

// voicemail hooks (loop task)
static PcmSourceFn   txSourceFn = NULL;        // loop generates the outgoing audio
static UlawSinkFn    rxSinkFn = NULL;          // copy of received audio
static uint32_t      txDueUs = 0;
static uint8_t       txFrac = 0;
static PcmSourceFn   localPlayFn = NULL;       // local earpiece playback (no call)
static UlawSinkFn    localMicFn = NULL;        // local microphone recording (no call)

// ---------------------------------------------------------------------------
// shared with capture/sender tasks on core 0
// ---------------------------------------------------------------------------
static portMUX_TYPE  mediaMux = portMUX_INITIALIZER_UNLOCKED;
static volatile bool     mediaActive = false;
static volatile uint32_t mediaGeneration = 0;  // bumped each time a call connects
static uint32_t      mediaCallId = 0;          // protected by mediaMux
static sockaddr_in   mediaPeer;                // protected by mediaMux
static volatile int32_t farEndLevel = 0;       // peak level of latest received frame (echo suppression)
static volatile bool     txFromLoop = false;   // capture task: don't send the mic, loop is sending
static volatile uint16_t txSeq = 0;            // outgoing audio sequence number (mic or loop)

enum LoopRoute : uint8_t { LR_NETWORK, LR_ECHO, LR_LOCALMIC };
static volatile uint8_t  loopRoute = LR_NETWORK;   // where the sender task delivers mic frames

// capture statistics, published by the capture task every 2 seconds
struct CaptureStats {
  uint32_t seq;           // increments each time a new set is published
  uint32_t samples;       // samples captured in the period
  uint32_t periodUs;
  int32_t  adcMin, adcMax;
  float    adcMean;
  float    micRms;        // RMS of the mic signal in ADC counts (after DC removal, before gain)
  uint32_t clipped;       // ADC readings stuck at 0 or 4095
  uint32_t txDropped;     // frames the sender couldn't keep up with
};
static CaptureStats      capStats;               // protected by mediaMux
static volatile uint32_t txQueueDrops = 0;

struct AudioFrame {
  uint32_t    callId;
  sockaddr_in peer;
  uint16_t    seq;
  uint8_t     data[VOIP_FRAME_SAMPLES];
};

static TaskHandle_t  captureTaskHandle = NULL;
static TaskHandle_t  senderTaskHandle = NULL;
static QueueHandle_t txQueue = NULL;
static QueueHandle_t loopQueue = NULL;         // echo test / local recording frames, sender task -> loop task
static QueueHandle_t dtmfQueue = NULL;         // software DTMF digits, capture task -> loop task
static volatile bool dialListen = false;       // decode DTMF from the ADC while dialing
static bool          timerRunning = false;
static bool          radioOffTest = false;     // echo test with the WiFi radio turned off

// noise spectrum: capture task fills specIn, sender task analyzes it, loop prints it
enum SpecState : uint8_t { SPEC_IDLE, SPEC_FILLING, SPEC_READY, SPEC_DONE, SPEC_SCAN_READY, SPEC_SCAN_DONE };
static volatile uint8_t specState = SPEC_IDLE;
static volatile bool  scanRequest = false;     // line scan: sample the ADC as fast as possible
static volatile float specFs = VOIP_SAMPLE_RATE;   // sample rate of the block in specIn
static float          specIn[SPEC_N], specRe[SPEC_N], specIm[SPEC_N];
static SpectrumReport specReport;
static hw_timer_t*   volatile sampleTimer = NULL;

// ---------------------------------------------------------------------------
// G.711 u-law
// ---------------------------------------------------------------------------
static int16_t ulawDecodeTable[256];

static uint8_t linearToUlaw(int32_t pcm) {
  const int32_t BIAS = 0x84, CLIP = 32635;
  uint8_t sign = 0;
  if (pcm < 0) { pcm = -pcm; sign = 0x80; }
  if (pcm > CLIP) pcm = CLIP;
  pcm += BIAS;
  uint8_t exponent = 7;
  for (int32_t mask = 0x4000; exponent > 0 && !(pcm & mask); exponent--, mask >>= 1) {}
  uint8_t mantissa = (pcm >> (exponent + 3)) & 0x0F;
  return ~(sign | (exponent << 4) | mantissa);
}

static int16_t ulawToLinear(uint8_t u) {
  u = ~u;
  int32_t t = (((int32_t)(u & 0x0F) << 3) + 0x84) << ((u & 0x70) >> 4);
  return (u & 0x80) ? (int16_t)(0x84 - t) : (int16_t)(t - 0x84);
}

uint8_t voipLinearToUlaw(int32_t pcm) { return linearToUlaw(pcm); }
int16_t voipUlawToLinear(uint8_t u)   { return ulawDecodeTable[u]; }

// ---------------------------------------------------------------------------
// playback jitter buffer (loop task only)
// ---------------------------------------------------------------------------
#define JB_SIZE        4096                              // power of 2, 0.5 sec
#define JB_MASK        (JB_SIZE - 1)
#define JB_PREBUFFER   ((VOIP_JITTER_MS * VOIP_SAMPLE_RATE) / 1000)
#define JB_HIGH_WATER  (JB_PREBUFFER + 3 * VOIP_FRAME_SAMPLES)
#define JB_LOW_WATER   (JB_PREBUFFER / 2)
#define LOCAL_FILL     (JB_PREBUFFER + 2 * VOIP_FRAME_SAMPLES)   // local playback buffer target

static int16_t  jb[JB_SIZE];
static uint16_t jbHead = 0, jbTail = 0;
static bool     jbPlaying = false;
static bool     jbLocal = false;                // local playback: no prebuffering or drift correction
static uint8_t  jbDropCounter = 0;
static int16_t  upPrev = 0, upCur = 0;
static uint8_t  upPhase = 0;

// playback statistics (loop task)
static uint32_t stOutSamples = 0, stUnderruns = 0, stDrops = 0, stRepeats = 0;
static uint32_t stRxFrames = 0, stLost = 0, stLate = 0;
static uint16_t stJbMin = 0xFFFF, stJbMax = 0;
static int32_t  stRxPeak = 0;

static inline uint16_t jbCount() { return (jbHead - jbTail) & JB_MASK; }

static void jbReset() {
  jbHead = jbTail = 0;
  jbPlaying = false;
  jbDropCounter = 0;
  upPrev = upCur = 0;
  upPhase = 0;
}

static inline void jbPush(int16_t s) {
  if (jbCount() == JB_MASK) jbTail = (jbTail + 1) & JB_MASK;  // full: discard oldest
  jb[jbHead] = s;
  jbHead = (jbHead + 1) & JB_MASK;
}

static inline int16_t jbPop() {
  uint16_t count = jbCount();
  if (jbLocal) {                                 // local playback: just play what's there
    if (count == 0) return 0;
    int16_t s = jb[jbTail];
    jbTail = (jbTail + 1) & JB_MASK;
    return s;
  }
  if (!jbPlaying) {
    if (count < JB_PREBUFFER) return 0;          // still filling
    jbPlaying = true;
  }
  if (count < stJbMin) stJbMin = count;
  if (count > stJbMax) stJbMax = count;
  if (count == 0) {                              // underrun: refill before playing again
    jbPlaying = false;
    stUnderruns++;
    return 0;
  }
  // the two nodes' sample clocks never match exactly.  Gently drop or repeat
  // a sample now and then to keep the buffer near its target level.
  if (count > JB_HIGH_WATER && ++jbDropCounter >= 32) {
    jbDropCounter = 0;
    jbTail = (jbTail + 1) & JB_MASK;          // far end faster: skip a sample
    stDrops++;
  } else if (count < JB_LOW_WATER && ++jbDropCounter >= 32) {
    jbDropCounter = 0;
    stRepeats++;
    return jb[jbTail];                        // far end slower: repeat a sample
  }
  int16_t s = jb[jbTail];
  jbTail = (jbTail + 1) & JB_MASK;
  return s;
}

bool voipAudioActive() {
  return (sess == SS_CONNECTED && !sessTrunk) || localPlayFn != NULL;
}

// called by Mozzi updateAudio() at AUDIO_RATE.  Linear interpolation up to AUDIO_RATE.
int16_t voipNextPlaybackSample() {
  stOutSamples++;
  if (upPhase == 0) {
    upPrev = upCur;
    upCur = jbPop();
  }
  int32_t s = upPrev + (((int32_t)(upCur - upPrev) * upPhase) / VOIP_UPSAMPLE);
  if (++upPhase >= VOIP_UPSAMPLE) upPhase = 0;
  return (int16_t)s;
}

static int16_t lastFrame[VOIP_FRAME_SAMPLES];    // previous frame, replayed to cover lost packets

static void handleAudioPayload(uint16_t seq, const uint8_t* data, uint16_t len) {
  if (len > VOIP_FRAME_SAMPLES) len = VOIP_FRAME_SAMPLES;
  if (sessGotAudio) {
    int16_t gap = (int16_t)(seq - sessLastRxSeq);
    if (gap <= 0) { stLate++; return; }          // duplicate or late packet
    if (gap > 1) stLost += gap - 1;
    if (gap > 1 && gap <= 5) {                   // lost packets: replay last frame, fading out, to keep timing
      for (int f = 1; f < gap; f++) {
        for (int i = 0; i < VOIP_FRAME_SAMPLES; i++) {
          lastFrame[i] /= 2;
          jbPush(lastFrame[i]);
        }
        if (rxSinkFn) {                          // recording: lost audio becomes silence
          uint8_t silence[VOIP_FRAME_SAMPLES];
          memset(silence, 0xFF, sizeof(silence));
          rxSinkFn(silence, VOIP_FRAME_SAMPLES);
        }
      }
    }
  }
  sessGotAudio = true;
  sessLastRxSeq = seq;
  stRxFrames++;
  if (rxSinkFn) rxSinkFn(data, len);

  int32_t peak = 0;
  for (uint16_t i = 0; i < len; i++) {
    int32_t s = (int32_t)(ulawDecodeTable[data[i]] * VOIP_SPEAKER_GAIN);
    if (s > 32767) s = 32767; else if (s < -32768) s = -32768;
    lastFrame[i] = (int16_t)s;
    jbPush((int16_t)s);
    int32_t a = s < 0 ? -s : s;
    if (a > peak) peak = a;
  }
  farEndLevel = peak;
  if (peak > stRxPeak) stRxPeak = peak;
}

// ---------------------------------------------------------------------------
// audio capture (core 0)
// ---------------------------------------------------------------------------
static void IRAM_ATTR onSampleTimer() {
  BaseType_t woken = pdFALSE;
  vTaskNotifyGiveFromISR(captureTaskHandle, &woken);
  if (woken) portYIELD_FROM_ISR();
}

static void captureTask(void*) {
  // create the sample timer from this task so its interrupt runs on core 0, away from Mozzi
  hw_timer_t* t = timerBegin(SAMPLE_TIMER_NUM, SAMPLE_TIMER_DIV, true);
  timerAttachInterrupt(t, &onSampleTimer, false);   // core 2.x only supports level interrupts
  timerAlarmWrite(t, SAMPLE_TIMER_TICKS, true);
  sampleTimer = t;                               // alarm is enabled while dialing or in a call

  uint32_t generation = 0;
  bool     wasIdle = true;
  AudioFrame frame;
  uint16_t idx = 0;
  uint16_t specIdx = 0;
  float hpX = 0, hpY = 0;                        // DC blocking high pass filter state
  float gateEnv = 0, gateFloor = 50, gate = 1.0f;  // adaptive noise gate
  float micEnv = 0, farEnv = 0, echoGain = 1.0f; // echo suppression
  float eqX1 = 0, eqY1 = 0;                      // mic EQ filter state
  const float scale = 16.0f * VOIP_MIC_GAIN;     // 12 bit ADC -> 16 bit audio
  DtmfDecoder dtmf(VOIP_SAMPLE_RATE, 15.0f);

  // statistics accumulators
  uint32_t stN = 0, stClip = 0, stStartUs = 0;
  int32_t  stMin = 4095, stMax = 0;
  float    stSum = 0, stSq = 0;

  for (;;) {
    ulTaskNotifyTake(pdFALSE, portMAX_DELAY);    // one notification per sample period

    if (scanRequest) {                           // line scan: grab a block as fast as the ADC allows
      scanRequest = false;
      uint32_t t0 = micros();
      for (int i = 0; i < SPEC_N; i++) specIn[i] = adc1_get_raw(MIC_ADC_CHANNEL);
      uint32_t t1 = micros();
      specFs = (float)SPEC_N * 1000000.0f / (float)(t1 - t0);
      specState = SPEC_SCAN_READY;
      wasIdle = true;
      continue;
    }

    int raw = 0;
    for (int k = 0; k < VOIP_ADC_OVERSAMPLE; k++) raw += adc1_get_raw(MIC_ADC_CHANNEL);
    float x = (float)raw / VOIP_ADC_OVERSAMPLE;

    bool active = mediaActive;
    bool listen = dialListen;
    if (!active && !listen) { wasIdle = true; continue; }
    if (wasIdle) {                               // (re)starting: settle the DC filter on this reading
      wasIdle = false;
      hpX = x;
      hpY = 0;
      dtmf.reset();
    }

    // remove the DC bias of the SLIC audio output (corner ~5 Hz).  hpY is in ADC counts.
    hpY = x - hpX + 0.996f * hpY;
    hpX = x;

#if VOIP_SOFTWARE_DTMF
    if (listen) {
      char d = dtmf.process(hpY);
      if (d) xQueueSend(dtmfQueue, &d, 0);
    }
#endif
    if (!active) continue;

    if (generation != mediaGeneration) {         // new call: reset filters, grab destination
      generation = mediaGeneration;
      portENTER_CRITICAL(&mediaMux);
      frame.callId = mediaCallId;
      frame.peer = mediaPeer;
      portEXIT_CRITICAL(&mediaMux);
      idx = 0;
      gateEnv = 0;
      gateFloor = 50;
      gate = 1.0f;
      eqX1 = eqY1 = 0;
      micEnv = farEnv = 0;
      echoGain = 1.0f;
      stN = stClip = 0; stMin = 4095; stMax = 0; stSum = stSq = 0;
      stStartUs = micros();
    }

    // statistics
    int32_t r = raw / VOIP_ADC_OVERSAMPLE;
    if (r < stMin) stMin = r;
    if (r > stMax) stMax = r;
    if (r <= 0 || r >= 4095) stClip++;
    stSum += x;
    stSq += hpY * hpY;
    if (++stN >= 2 * VOIP_SAMPLE_RATE) {         // publish every 2 seconds
      uint32_t nowUs = micros();
      portENTER_CRITICAL(&mediaMux);
      capStats.samples = stN;
      capStats.periodUs = nowUs - stStartUs;
      capStats.adcMin = stMin;
      capStats.adcMax = stMax;
      capStats.adcMean = stSum / stN;
      capStats.micRms = sqrtf(stSq / stN);
      capStats.clipped = stClip;
      capStats.txDropped = txQueueDrops;
      capStats.seq++;
      portEXIT_CRITICAL(&mediaMux);
      stN = stClip = 0; stMin = 4095; stMax = 0; stSum = stSq = 0;
      stStartUs = nowUs;
    }
    if (specState == SPEC_FILLING) {             // grab a block for the noise spectrum report
      specIn[specIdx++] = hpY;
      if (specIdx >= SPEC_N) { specIdx = 0; specState = SPEC_READY; }
    } else {
      specIdx = 0;
    }

    float s = hpY * scale;

#if VOIP_MIC_EQ_HZ > 0
    // undo the roll off of an RC filter capacitor on GPIO32: inverse of a one
    // pole low pass at VOIP_MIC_EQ_HZ, with the boost leveled off near 3.4 kHz
    {
      static const float eqA = expf(-2.0f * (float)M_PI * VOIP_MIC_EQ_HZ / VOIP_SAMPLE_RATE);
      static const float eqB = expf(-2.0f * (float)M_PI * 3400.0f / VOIP_SAMPLE_RATE);
      float u = (s - eqA * eqX1) / (1.0f - eqA);
      eqX1 = s;
      eqY1 = (1.0f - eqB) * u + eqB * eqY1;
      s = eqY1;
    }
#endif

#if VOIP_NOISE_GATE
    // adaptive gate: learns the background noise level and quiets the mic
    // whenever the signal isn't clearly (~10 dB) above it
    {
      float a = hpY < 0 ? -hpY : hpY;
      gateEnv = (a > gateEnv) ? a : gateEnv * 0.999f;           // ~120 mS release
      if (gateEnv < gateFloor) gateFloor += (gateEnv - gateFloor) * 0.002f;
      else gateFloor *= 1.00003f;                               // creeps up ~30%/sec
      if (gateFloor < 1.0f) gateFloor = 1.0f;
      float gTarget = (gateEnv > gateFloor * 3.0f) ? 1.0f : 0.1f;
      gate += (gTarget - gate) * (gTarget > gate ? 0.05f : 0.0005f);
      s *= gate;
    }
#endif

#if VOIP_ECHO_SUPPRESS
    if (loopRoute == LR_NETWORK) {
      float m = s < 0 ? -s : s;
      micEnv = (m > micEnv) ? m : micEnv * 0.999f;
      float f = (float)farEndLevel;
      farEnv = (f > farEnv) ? f : farEnv * 0.9995f;
      // far end talking and we're not clearly louder than its echo: duck the mic
      float eTarget = (farEnv > 500.0f && micEnv < farEnv * VOIP_ECHO_RATIO) ? 0.1f : 1.0f;
      echoGain += (eTarget - echoGain) * (eTarget < echoGain ? 0.02f : 0.001f);
      s *= echoGain;
    }
#endif
    (void)eqX1; (void)eqY1;
    (void)gateEnv; (void)gateFloor; (void)gate; (void)micEnv; (void)farEnv; (void)echoGain;

    int32_t pcm = (int32_t)s;
    if (pcm > 32767) pcm = 32767; else if (pcm < -32768) pcm = -32768;
    frame.data[idx++] = linearToUlaw(pcm);

    if (idx >= VOIP_FRAME_SAMPLES) {
      idx = 0;
      if (!txFromLoop) {                         // voicemail may be sending instead of the mic
        frame.seq = txSeq;
        txSeq = txSeq + 1;
        if (xQueueSend(txQueue, &frame, 0) != pdTRUE) txQueueDrops++;   // sender is behind: drop
      }
    }
  }
}

static void senderTask(void*) {
  AudioFrame frame;
  uint8_t pkt[MAX_PACKET];
  PacketHeader* h = (PacketHeader*)pkt;
  for (;;) {
    if (specState == SPEC_READY) {               // noise report: FFT runs here, at low priority
      analyzeSpectrum(specIn, specRe, specIm, VOIP_SAMPLE_RATE, specReport);
      specState = SPEC_DONE;
    } else if (specState == SPEC_SCAN_READY) {   // line scan
      analyzeSpectrum(specIn, specRe, specIm, specFs, specReport);
      specState = SPEC_SCAN_DONE;
    }
    if (xQueueReceive(txQueue, &frame, pdMS_TO_TICKS(50)) != pdTRUE) continue;
    if (!mediaActive) continue;
    if (loopRoute != LR_NETWORK) {               // echo test / local recording: hand the frame to loop()
      xQueueSend(loopQueue, &frame, 0);
      continue;
    }
    h->magic[0] = 'S';
    h->magic[1] = 'L';
    h->version = PROTOCOL_VERSION;
    h->type = PKT_AUDIO;
    h->callId = frame.callId;
    h->seq = frame.seq;
    h->len = VOIP_FRAME_SAMPLES;
    memcpy(pkt + sizeof(PacketHeader), frame.data, VOIP_FRAME_SAMPLES);
    sendto(audioTxSock, pkt, sizeof(PacketHeader) + VOIP_FRAME_SAMPLES, 0,
           (const sockaddr*)&frame.peer, sizeof(frame.peer));
  }
}

static unsigned long statsLastMs = 0;
static uint32_t      statsLastCapSeq = 0;

static void resetPlaybackStats() {
  stOutSamples = stUnderruns = stDrops = stRepeats = 0;
  stRxFrames = stLost = stLate = 0;
  stJbMin = 0xFFFF; stJbMax = 0;
  stRxPeak = 0;
}

// run the sample timer only while dialing or capturing audio
static void updateSampleTimer() {
  bool want = mediaActive || dialListen;
  if (want == timerRunning || sampleTimer == NULL) return;
  timerRunning = want;
  if (want) {
    timerWrite(sampleTimer, 0);
    timerAlarmEnable(sampleTimer);
  } else {
    timerAlarmDisable(sampleTimer);
  }
}

static void startMedia() {
  jbReset();
  jbLocal = false;
  resetPlaybackStats();
  statsLastMs = millis();
  sessGotAudio = false;
  portENTER_CRITICAL(&mediaMux);
  mediaCallId = sessCallId;
  mediaPeer = sessPeer;
  portEXIT_CRITICAL(&mediaMux);
  farEndLevel = 0;
  txSeq = 0;
  mediaGeneration = mediaGeneration + 1;
  mediaActive = true;
  specState = SPEC_FILLING;
  updateSampleTimer();
}

static void stopMedia() {
  mediaActive = false;
  updateSampleTimer();
  jbReset();
  xQueueReset(loopQueue);
}

// ---------------------------------------------------------------------------
// signaling
// ---------------------------------------------------------------------------
static void sendControl(PacketType type, uint32_t callId, const sockaddr_in& to,
                        const void* payload = NULL, uint16_t len = 0) {
  uint8_t pkt[sizeof(PacketHeader) + sizeof(InvitePayload)];
  PacketHeader* h = (PacketHeader*)pkt;
  h->magic[0] = 'S';
  h->magic[1] = 'L';
  h->version = PROTOCOL_VERSION;
  h->type = type;
  h->callId = callId;
  h->seq = 0;
  h->len = len;
  if (len) memcpy(pkt + sizeof(PacketHeader), payload, len);
  sendto(sock, pkt, sizeof(PacketHeader) + len, 0, (const sockaddr*)&to, sizeof(to));
  sessLastTxMs = millis();
}

static void sendInvite() {
  InvitePayload inv;
  memset(&inv, 0, sizeof(inv));
  strncpy(inv.from, localPhoneNumber.c_str(), sizeof(inv.from) - 1);
  strncpy(inv.to, sessDialedNumber.c_str(), sizeof(inv.to) - 1);
  inv.flags = (sessTrunk ? INV_TRUNK : 0) | (sessPeerBroadcast ? INV_BROADCAST : 0);
  sendControl(PKT_INVITE, sessCallId, sessPeer, &inv, sizeof(inv));
}

static void setEvent(VoipEvent ev) {
  pendingEvent = ev;
}

static void endSession() {
  stopMedia();
  sess = SS_IDLE;
  sessCallId = 0;
  sessTrunk = false;
  sessPeerBroadcast = false;
  loopRoute = LR_NETWORK;
  txSourceFn = NULL;
  txFromLoop = false;
  rxSinkFn = NULL;
  if (radioOffTest) {                            // echo test turned the radio off: reconnect
    radioOffTest = false;
    Serial.println(F("[voip] WiFi radio back on, reconnecting"));
    wifiStart();
  }
}

// does this packet belong to the call in progress?
static bool fromPeer(const sockaddr_in& src, uint32_t callId) {
  if (sess == SS_IDLE || callId != sessCallId) return false;
  if (sessPeerBroadcast) {                       // first reply to a broadcast call: that's the far end
    sessPeer = src;
    sessPeer.sin_port = htons(VOIP_UDP_PORT);
    sessPeerBroadcast = false;
    Serial.printf("[voip] %s answered from %s\r\n", sessDialedNumber.c_str(), inet_ntoa(src.sin_addr));
    return true;
  }
  return src.sin_addr.s_addr == sessPeer.sin_addr.s_addr;
}

static void connectCall() {
  sess = SS_CONNECTED;
  sessLastRxMs = millis();
  if (!sessTrunk) startMedia();                  // phone line calls: the relay carries the audio
  setEvent(VOIP_EV_ANSWERED);
  Serial.println(sessTrunk ? F("[voip] call connected over the phone line") : F("[voip] call connected"));
}

// accept an incoming INVITE as the session
static void takeInvite(const PacketHeader* h, const InvitePayload& inv, const sockaddr_in& src) {
  sess = SS_IN_RINGING;
  sessCallId = h->callId;
  sessPeer = src;
  sessPeer.sin_port = htons(VOIP_UDP_PORT);
  sessPeerBroadcast = false;
  sessTrunk = (inv.flags & INV_TRUNK) != 0;
  sessPeerNumber = inv.from;
  sessDialedNumber = "";
  sessStartMs = sessLastRxMs = millis();
  remotePhoneNum = inv.from;
}

static void handlePacket(const uint8_t* buf, int len, const sockaddr_in& src) {
  if (len < (int)sizeof(PacketHeader)) return;
  const PacketHeader* h = (const PacketHeader*)buf;
  if (h->magic[0] != 'S' || h->magic[1] != 'L' || h->version != PROTOCOL_VERSION) return;
  if ((int)(sizeof(PacketHeader) + h->len) > len) return;
  const uint8_t* payload = buf + sizeof(PacketHeader);
  unsigned long now = millis();

  if (h->type == PKT_INVITE) {
    if (h->len < sizeof(InvitePayload)) return;
    InvitePayload inv;
    memcpy(&inv, payload, sizeof(inv));
    inv.from[sizeof(inv.from) - 1] = 0;
    inv.to[sizeof(inv.to) - 1] = 0;
    bool broadcast = (inv.flags & INV_BROADCAST) != 0;

    if (localPhoneNumber.length() == 0 || localPhoneNumber != inv.to) {
      if (!broadcast) {                          // sent straight to us but not our number
        Serial.printf("[voip] call for %s arrived here (this is %s) - check the directory IPs\r\n",
                      inv.to, localPhoneNumber.c_str());
        sendControl(PKT_BUSY, h->callId, src);
      }
      return;                                    // broadcast for another node: ignore
    }
    if (sess != SS_IDLE && h->callId == sessCallId && src.sin_addr.s_addr == sessPeer.sin_addr.s_addr) {
      sessLastRxMs = now;                        // repeat of the call already in progress
      if (sess == SS_IN_RINGING) sendControl(PKT_RINGING, h->callId, src);
      else if (sess == SS_CONNECTED) sendControl(PKT_ANSWER, h->callId, src);  // our answer was lost
      return;
    }

    // both phones called each other at the same moment (eg. two Batphones picked
    // up together).  The node with the higher number gives up its own call and
    // answers the other one, so the two get connected instead of both busy.
    if ((sess == SS_OUT_INVITING || sess == SS_OUT_RINGING) && sessDialedNumber == inv.from) {
      if (localPhoneNumber > String(inv.from)) {
        for (int i = 0; i < 2; i++) sendControl(PKT_HANGUP, sessCallId, sessPeer);
        takeInvite(h, inv, src);
        sendControl(PKT_ANSWER, sessCallId, sessPeer);
        sendControl(PKT_ANSWER, sessCallId, sessPeer);
        Serial.println(F("[voip] both phones called each other - connecting"));
        connectCall();
      }
      return;                                    // lower number: wait for the other node to answer ours
    }

    if (sess != SS_IDLE || nodeBusy()) {
      sendControl(PKT_BUSY, h->callId, src);
      return;
    }
    // new incoming call
    takeInvite(h, inv, src);
    sendControl(PKT_RINGING, h->callId, src);
    setEvent(VOIP_EV_INCOMING);
    Serial.printf("[voip] incoming %scall from %s (%s)\r\n", sessTrunk ? "phone line " : "",
                  inv.from, inet_ntoa(src.sin_addr));
    return;
  }

  if (!fromPeer(src, h->callId)) return;         // everything else must belong to our call
  sessLastRxMs = now;

  switch (h->type) {
    case PKT_RINGING:
      if (sess == SS_OUT_INVITING) {
        sess = SS_OUT_RINGING;
        setEvent(VOIP_EV_RINGING);
        Serial.println(F("[voip] far end ringing"));
      }
      break;

    case PKT_BUSY:
      if (sess == SS_OUT_INVITING || sess == SS_OUT_RINGING) {
        endSession();
        setEvent(VOIP_EV_BUSY);
        Serial.println(F("[voip] far end busy"));
      }
      break;

    case PKT_ANSWER:
      if (sess == SS_OUT_INVITING || sess == SS_OUT_RINGING) connectCall();
      break;

    case PKT_HANGUP:
      endSession();
      setEvent(VOIP_EV_HANGUP);
      Serial.println(F("[voip] far end hung up"));
      break;

    case PKT_AUDIO:
      if (sess == SS_OUT_INVITING || sess == SS_OUT_RINGING) connectCall();   // answer packet was lost
      if (sess == SS_CONNECTED && !sessTrunk) handleAudioPayload(h->seq, payload, h->len);
      break;

    case PKT_KEEPALIVE:
      if ((sess == SS_OUT_INVITING || sess == SS_OUT_RINGING) && sessTrunk) connectCall();  // answer was lost
      break;
  }
}

static void runTimers() {
  unsigned long now = millis();
  switch (sess) {
    case SS_OUT_INVITING:
      if (now - sessStartMs > INVITE_GIVEUP_MS) {
        Serial.println(F("[voip] no answer from far end node"));
        endSession();
        setEvent(VOIP_EV_TIMEOUT);
      } else if (now - sessLastTxMs > INVITE_RESEND_MS) {
        sendInvite();
      }
      break;

    case SS_OUT_RINGING:
      if (now - sessLastRxMs > PEER_TIMEOUT_MS) {
        Serial.println(F("[voip] far end node stopped responding"));
        endSession();
        setEvent(VOIP_EV_TIMEOUT);
      } else if (now - sessLastTxMs > RINGING_KEEPALIVE_MS) {
        sendInvite();
      }
      break;

    case SS_IN_RINGING:
      if (now - sessLastRxMs > PEER_TIMEOUT_MS) {   // caller vanished without hanging up
        Serial.println(F("[voip] caller went away"));
        endSession();
        setEvent(VOIP_EV_HANGUP);
      }
      break;

    case SS_CONNECTED:
      if (loopRoute == LR_ECHO) break;           // echo test: no far end
      if (now - sessLastRxMs > PEER_TIMEOUT_MS) {
        Serial.println(F("[voip] lost contact with far end"));
        endSession();
        setEvent(VOIP_EV_TIMEOUT);
      } else if (now - sessLastTxMs > CONNECTED_KEEPALIVE_MS) {
        sendControl(PKT_KEEPALIVE, sessCallId, sessPeer);
      }
      break;

    default:
      break;
  }
}

// voicemail is sending: build and send audio frames from txSourceFn on time
static void runTxSource() {
  if (!txSourceFn || sess != SS_CONNECTED || sessTrunk) return;
  uint32_t now = micros();
  if ((int32_t)(now - txDueUs) > 200000) txDueUs = now;   // fell far behind: resync
  while ((int32_t)(now - txDueUs) >= 0) {
    int16_t pcm[VOIP_FRAME_SAMPLES];
    int n = txSourceFn(pcm, VOIP_FRAME_SAMPLES);
    if (n < 0) n = 0;
    for (int i = n; i < VOIP_FRAME_SAMPLES; i++) pcm[i] = 0;   // nothing to say: silence

    uint8_t pkt[MAX_PACKET];
    PacketHeader* h = (PacketHeader*)pkt;
    h->magic[0] = 'S';
    h->magic[1] = 'L';
    h->version = PROTOCOL_VERSION;
    h->type = PKT_AUDIO;
    h->callId = sessCallId;
    h->seq = txSeq;
    txSeq = txSeq + 1;
    h->len = VOIP_FRAME_SAMPLES;
    for (int i = 0; i < VOIP_FRAME_SAMPLES; i++) pkt[sizeof(PacketHeader) + i] = linearToUlaw(pcm[i]);
    sendto(sock, pkt, sizeof(PacketHeader) + VOIP_FRAME_SAMPLES, 0, (const sockaddr*)&sessPeer, sizeof(sessPeer));

    txDueUs += 19531;                            // 160 / 8192 sec = 19531.25 uS
    if (++txFrac >= 4) { txFrac = 0; txDueUs += 1; }
  }
}

// local playback: keep the earpiece buffer topped up from localPlayFn
static void runLocalPlayback() {
  if (!localPlayFn) return;
  while (jbCount() < LOCAL_FILL) {
    int16_t pcm[VOIP_FRAME_SAMPLES];
    int n = localPlayFn(pcm, VOIP_FRAME_SAMPLES);
    if (n <= 0) break;
    for (int i = 0; i < n; i++) jbPush(pcm[i]);
  }
}

// ---------------------------------------------------------------------------
// directory
// ---------------------------------------------------------------------------
#define DIR settings.directory
#define DIRN settings.directoryCount

int voipLookupNumber(const String& num) {
  for (int i = 0; i < DIRN; i++)
    if (num == DIR[i].number) return i;
  return -1;
}

bool voipIsPrefixOfAnyNumber(const String& digits) {
  for (int i = 0; i < DIRN; i++)
    if (DIR[i].number.startsWith(digits)) return true;
  return false;
}

// one line of call audio statistics every 2 seconds (see README "Troubleshooting call audio")
static void printStats() {
#if VOIP_STATS
  if (sess != SS_CONNECTED || sessTrunk) return;
  unsigned long now = millis();
  if (now - statsLastMs < 2000) return;
  float secs = (now - statsLastMs) / 1000.0f;
  statsLastMs = now;

  CaptureStats cs;
  portENTER_CRITICAL(&mediaMux);
  cs = capStats;
  portEXIT_CRITICAL(&mediaMux);
  bool haveCap = (cs.seq != statsLastCapSeq);
  statsLastCapSeq = cs.seq;

  Serial.printf("[stats] out %u/s  rx %u fr/s lost %u late %u  underrun %u  buf %u-%u mS  skip %u rep %u  rxpeak %d",
                (unsigned)(stOutSamples / secs), (unsigned)(stRxFrames / secs), (unsigned)stLost, (unsigned)stLate,
                (unsigned)stUnderruns,
                (unsigned)((stJbMin == 0xFFFF ? 0 : stJbMin) * 1000UL / VOIP_SAMPLE_RATE),
                (unsigned)(stJbMax * 1000UL / VOIP_SAMPLE_RATE),
                (unsigned)stDrops, (unsigned)stRepeats, (int)stRxPeak);
  if (haveCap && cs.periodUs) {
    Serial.printf("  | mic %u/s adc %d..%d mean %.0f noise %.1f clip %u txdrop %u",
                  (unsigned)(cs.samples * 1000000ULL / cs.periodUs), (int)cs.adcMin, (int)cs.adcMax,
                  cs.adcMean, cs.micRms, (unsigned)cs.clipped, (unsigned)cs.txDropped);
  }
  Serial.println();
  if (specState == SPEC_DONE) {
    Serial.printf("[noise] mic spectrum (ADC counts rms): hum<300Hz %.1f  voice 300-3400Hz %.1f  high>3400Hz %.1f  tones:",
                  specReport.hum, specReport.voice, specReport.high);
    if (specReport.nPeaks == 0) Serial.print(" none");
    for (int i = 0; i < specReport.nPeaks; i++)
      Serial.printf(" %.0fHz(%.1f)", specReport.peakHz[i], specReport.peakAmp[i]);
    Serial.println();
    specState = SPEC_FILLING;                    // take another block for the next report
  }
  resetPlaybackStats();
#endif
}

static void printScan() {
  if (specState != SPEC_SCAN_DONE) return;
  specState = SPEC_IDLE;
  float fs = specFs;
  Serial.printf("[scan] receive audio sampled at %.0f Hz (shows up to %.0f Hz)\r\n", fs, fs / 2);
  Serial.printf("[scan] noise (ADC counts rms): <300Hz %.1f  300-3400Hz %.1f  >3400Hz %.1f\r\n",
                specReport.hum, specReport.voice, specReport.high);
  if (specReport.nPeaks == 0) Serial.println(F("[scan] no tones standing out of the noise"));
  for (int i = 0; i < specReport.nPeaks; i++) {
    float f = specReport.peakHz[i];
    float alias = fabsf(f - VOIP_SAMPLE_RATE * roundf(f / VOIP_SAMPLE_RATE));
    Serial.printf("[scan] tone %.0f Hz, %.1f counts", f, specReport.peakAmp[i]);
    if (f > VOIP_SAMPLE_RATE / 2) Serial.printf("  -> heard in calls as %.0f Hz (above the 4096 Hz limit, aliased)", alias);
    Serial.println();
  }
}

// ---------------------------------------------------------------------------
// public API
// ---------------------------------------------------------------------------

// start (or restart) the WiFi connection.  Doesn't wait for it to connect.
static void wifiStart() {
  WiFi.mode(WIFI_STA);
  WiFi.setSleep(VOIP_WIFI_POWERSAVE ? true : false);   // power save adds 100+ mS of audio latency/jitter
  String ipText = settings.staticIp;
  if (ipText.length() == 0 && myEntry >= 0 && DIR[myEntry].mac.length())
    ipText = DIR[myEntry].ip;                    // older setup: directory entry with this board's MAC sets the IP
  IPAddress ip, gw, mask, dns;
  if (ipText.length() && ip.fromString(ipText.c_str())) {
    gw.fromString(settings.gateway.c_str());
    mask.fromString(settings.subnet.c_str());
    if (!dns.fromString(settings.dns.c_str())) dns = gw;
    WiFi.config(ip, gw, mask, dns);
  }
  WiFi.begin(settings.wifiSsid.c_str(), settings.wifiPass.c_str());
}

// couldn't join the WiFi network: become an access point so the config page can be reached
static void startAccessPoint() {
  apMode = true;
  String mac = WiFi.macAddress();
  mac.replace(":", "");
  String ssid = String(VOIP_AP_SSID_PREFIX) + mac.substring(8);
  WiFi.disconnect(true);
  WiFi.mode(WIFI_AP_STA);                        // STA side allows scanning for networks from the config page
  bool secure = settings.adminPassword.length() >= 8;
  WiFi.softAP(ssid.c_str(), secure ? settings.adminPassword.c_str() : NULL);
  delay(200);
  dnsServer = new DNSServer();
  dnsServer->start(53, "*", WiFi.softAPIP());    // captive portal: any name goes to us
  Serial.println(F("\r\n*** Could not join the WiFi network."));
  Serial.printf("*** Started access point \"%s\" %s\r\n", ssid.c_str(),
                secure ? (String("password ") + settings.adminPassword).c_str() : "(open)");
  Serial.printf("*** Connect to it and browse to http://%s/ to set up WiFi\r\n", WiFi.softAPIP().toString().c_str());
}

bool voipInAccessPointMode() { return apMode; }

String voipIpAddress() {
  return apMode ? WiFi.softAPIP().toString() : WiFi.localIP().toString();
}

bool voipBegin() {
  for (int i = 0; i < 256; i++) ulawDecodeTable[i] = ulawToLinear(i);

  // ---- WiFi ----
  WiFi.mode(WIFI_STA);
  String myMac = WiFi.macAddress();
  Serial.print(F("WiFi MAC address: "));
  Serial.println(myMac);
  for (int i = 0; i < DIRN; i++) {
    if (DIR[i].mac.length() && myMac.equalsIgnoreCase(DIR[i].mac.c_str())) {
      myEntry = i;
      break;
    }
  }

  Serial.print(F("Connecting to WiFi "));
  Serial.print(settings.wifiSsid);
  bool connected = false;
  if (settings.wifiSsid.length()) {
    wifiStart();
    for (int attempts = 0; attempts < VOIP_WIFI_CONNECT_SECONDS; attempts++) {
      if (WiFi.status() == WL_CONNECTED) { connected = true; break; }
      Serial.print(".");
      delay(1000);
    }
  }
  if (connected) {
    digitalWrite(LED_BUILTIN, HIGH);             // show WiFi connected on ESP32 module LED
    Serial.print(F("\r\nIP address: "));
    Serial.println(WiFi.localIP());
  } else {
    startAccessPoint();
  }

  if (settings.myNumber.length()) {              // number set on the config page / voip_config.h
    localPhoneNumber = settings.myNumber;
  } else {
    if (myEntry < 0 && connected) {              // no MAC match: identify by our IP address
      String myIp = WiFi.localIP().toString();
      for (int i = 0; i < DIRN; i++)
        if (myIp == DIR[i].ip) myEntry = i;
    }
    if (myEntry >= 0) localPhoneNumber = DIR[myEntry].number;
  }
  if (localPhoneNumber.length()) {
    Serial.print(F("This phone's number: "));
    Serial.println(localPhoneNumber);
    if (!apMode) {                               // also reachable as http://slim-<number>.local/
      String host = String("slim-") + localPhoneNumber;
      if (MDNS.begin(host.c_str())) MDNS.addService("http", "tcp", 80);
    }
  } else {
    Serial.println(F("*** This phone's number isn't set and its IP/MAC isn't in the directory. It can call out but can't be called."));
  }

  // ---- UDP sockets ----
  sock = socket(AF_INET, SOCK_DGRAM, IPPROTO_UDP);
  sockaddr_in local;
  memset(&local, 0, sizeof(local));
  local.sin_family = AF_INET;
  local.sin_port = htons(VOIP_UDP_PORT);
  local.sin_addr.s_addr = htonl(INADDR_ANY);
  if (sock < 0 || bind(sock, (sockaddr*)&local, sizeof(local)) < 0) {
    Serial.println(F("[voip] could not open UDP port"));
    return false;
  }
  int yes = 1;
  setsockopt(sock, SOL_SOCKET, SO_BROADCAST, &yes, sizeof(yes));   // phone line calls find the far node by broadcast
  fcntl(sock, F_SETFL, fcntl(sock, F_GETFL, 0) | O_NONBLOCK);
  audioTxSock = socket(AF_INET, SOCK_DGRAM, IPPROTO_UDP);

  // ---- audio capture: ADC1 channel 4 (GPIO32) ----
  adc1_config_width(ADC_WIDTH_BIT_12);
#if   VOIP_ADC_ATTEN_DB == 0
  adc1_config_channel_atten(MIC_ADC_CHANNEL, (adc_atten_t)0);   // 0 dB:   ~0.1 - 0.95 V
#elif VOIP_ADC_ATTEN_DB == 2
  adc1_config_channel_atten(MIC_ADC_CHANNEL, (adc_atten_t)1);   // 2.5 dB: ~0.1 - 1.25 V
#elif VOIP_ADC_ATTEN_DB == 6
  adc1_config_channel_atten(MIC_ADC_CHANNEL, (adc_atten_t)2);   // 6 dB:   ~0.15 - 1.75 V
#else
  adc1_config_channel_atten(MIC_ADC_CHANNEL, (adc_atten_t)3);   // 11 dB:  ~0.15 - 2.45 V
#endif

  txQueue = xQueueCreate(8, sizeof(AudioFrame));
  loopQueue = xQueueCreate(8, sizeof(AudioFrame));
  dtmfQueue = xQueueCreate(8, sizeof(char));
  // highest priority on core 0 so WiFi processing can't delay (jitter) the ADC samples
  xTaskCreatePinnedToCore(captureTask, "voipCapture", 4096, NULL, configMAX_PRIORITIES - 1, &captureTaskHandle, 0);
  xTaskCreatePinnedToCore(senderTask,  "voipSend",    4096, NULL, 5,  &senderTaskHandle,  0);
  while (sampleTimer == NULL) delay(1);          // wait for capture task to set up its timer
  return true;
}

void voipPoll() {
  runTxSource();                                 // voicemail audio is timing critical: check every pass
  runLocalPlayback();

  unsigned long nowUs = micros();
  if (nowUs - lastPollUs < POLL_INTERVAL_US) return;   // keep loop() fast for Mozzi
  lastPollUs = nowUs;

  if (apMode) {
    if (dnsServer) dnsServer->processNextRequest();
    digitalWrite(LED_BUILTIN, (millis() / 500) & 1);   // blinking: access point mode
  } else {
    digitalWrite(LED_BUILTIN, WiFi.status() == WL_CONNECTED);
  }
  if (sock < 0) return;

  uint8_t buf[MAX_PACKET + 16];
  for (int n = 0; n < 16; n++) {                 // drain everything that has arrived
    sockaddr_in src;
    socklen_t srcLen = sizeof(src);
    int len = recvfrom(sock, buf, sizeof(buf), 0, (sockaddr*)&src, &srcLen);
    if (len <= 0) break;
    handlePacket(buf, len, src);
  }

  // frames looped back from our own microphone: echo test or local recording
  AudioFrame lf;
  while (loopQueue && xQueueReceive(loopQueue, &lf, 0) == pdTRUE) {
    if (loopRoute == LR_ECHO && sess == SS_CONNECTED) {
      sessLastRxMs = millis();
      handleAudioPayload(lf.seq, lf.data, VOIP_FRAME_SAMPLES);
    } else if (loopRoute == LR_LOCALMIC && localMicFn) {
      localMicFn(lf.data, VOIP_FRAME_SAMPLES);
    }
  }

  runTimers();
  printStats();
  printScan();
}

VoipEvent voipGetEvent() {
  VoipEvent ev = pendingEvent;
  pendingEvent = VOIP_EV_NONE;
  return ev;
}

bool voipPlaceCall(const String& num) {
  int i = voipLookupNumber(num);
  if (i < 0 || sock < 0) return false;
  if (sess != SS_IDLE) voipHangup();
  voipLocalStop();

  memset(&sessPeer, 0, sizeof(sessPeer));
  sessPeer.sin_family = AF_INET;
  sessPeer.sin_port = htons(VOIP_UDP_PORT);
  if (DIR[i].ip.length() == 0) {                 // no IP: phone line call, find the node by broadcast
    sessTrunk = true;
    sessPeerBroadcast = true;
    if (apMode) {                                // our own access point: 192.168.4.255
      IPAddress b = WiFi.softAPIP();
      b[3] = 255;
      sessPeer.sin_addr.s_addr = (uint32_t)b;
    } else {
      sessPeer.sin_addr.s_addr = (uint32_t)WiFi.broadcastIP();
    }
  } else {
    IPAddress ip;
    if (!ip.fromString(DIR[i].ip.c_str())) return false;
    sessTrunk = false;
    sessPeerBroadcast = false;
    sessPeer.sin_addr.s_addr = (uint32_t)ip;
  }

  do { sessCallId = esp_random(); } while (sessCallId == 0);
  sessDialedNumber = num;
  sessPeerNumber = num;
  sess = SS_OUT_INVITING;
  sessStartMs = sessLastRxMs = millis();
  pendingEvent = VOIP_EV_NONE;
  if (sessTrunk) Serial.printf("[voip] calling %s over the phone line\r\n", num.c_str());
  else Serial.printf("[voip] calling %s at %s\r\n", num.c_str(), DIR[i].ip.c_str());
  sendInvite();
  return true;
}

void voipAnswer() {
  if (sess != SS_IN_RINGING) return;
  sendControl(PKT_ANSWER, sessCallId, sessPeer);
  sendControl(PKT_ANSWER, sessCallId, sessPeer);
  connectCall();
  pendingEvent = VOIP_EV_NONE;                   // the state machine already knows
}

void voipHangup() {
  if (sess == SS_IDLE) return;
  if (loopRoute != LR_ECHO)
    for (int i = 0; i < 3; i++) sendControl(PKT_HANGUP, sessCallId, sessPeer);
  Serial.println(F("[voip] hung up"));
  endSession();
  pendingEvent = VOIP_EV_NONE;
}

bool voipCallActive() {
  return sess != SS_IDLE;
}

bool voipCallIsTrunk() {
  return sess != SS_IDLE && sessTrunk;
}

String voipPeerNumber() {
  return sessPeerNumber;
}

// echo test: send this phone's own audio through the encoder, jitter buffer and
// decoder and straight back to its own earpiece, without using the network.
bool voipStartLoopback(bool radioOff) {
  if (sess != SS_IDLE) voipHangup();
  if (apMode) radioOff = false;                  // access point mode: keep the radio on
  voipLocalStop();
  if (radioOff) {                                // take WiFi completely out of the picture
    radioOffTest = true;
    WiFi.disconnect(true);
    WiFi.mode(WIFI_OFF);
    Serial.println(F("[voip] echo test with WiFi radio OFF"));
  }
  do { sessCallId = esp_random(); } while (sessCallId == 0);
  memset(&sessPeer, 0, sizeof(sessPeer));
  sessTrunk = false;
  loopRoute = LR_ECHO;
  sess = SS_CONNECTED;
  sessLastRxMs = millis();
  startMedia();
  pendingEvent = VOIP_EV_NONE;
  Serial.println(F("[voip] echo test: you should hear yourself ~80 mS late"));
  return true;
}

// line scan: sample the receive audio as fast as the ADC allows and report
// noise and tones up to well above the 4 kHz call bandwidth.  Result prints
// on the serial monitor from voipPoll().  Only while no call is connected.
bool voipLineScan() {
  if (sess != SS_IDLE || captureTaskHandle == NULL) return false;
  scanRequest = true;
  xTaskNotifyGive(captureTaskHandle);
  return true;
}

// decode DTMF from the ADC while the phone is dialing (backs up the MT8870)
void voipSetDialListen(bool on) {
  if (on == dialListen) return;
#if VOIP_SOFTWARE_DTMF
  if (on) xQueueReset(dtmfQueue);
  dialListen = on;
  updateSampleTimer();
#endif
}

char voipGetDtmfDigit() {
  char d = 0;
  if (dtmfQueue && xQueueReceive(dtmfQueue, &d, 0) == pdTRUE) return d;
  return 0;
}

void voipSetTxSource(PcmSourceFn fn) {
  if (fn && !txSourceFn) {
    txDueUs = micros();
    txFrac = 0;
  }
  txSourceFn = fn;
  txFromLoop = (fn != NULL);
}

void voipSetRxSink(UlawSinkFn fn) {
  rxSinkFn = fn;
}

bool voipLocalStart(PcmSourceFn play, UlawSinkFn mic) {
  if (sess != SS_IDLE) return false;
  voipLocalStop();
  jbReset();
  jbLocal = true;
  localPlayFn = play;
  localMicFn = mic;
  if (mic) {                                     // capture the microphone and hand frames to mic()
    loopRoute = LR_LOCALMIC;
    xQueueReset(loopQueue);
    mediaGeneration = mediaGeneration + 1;
    mediaActive = true;
    updateSampleTimer();
  }
  return true;
}

void voipLocalStop() {
  if (localMicFn) {
    mediaActive = false;
    updateSampleTimer();
    loopRoute = LR_NETWORK;
  }
  localPlayFn = NULL;
  localMicFn = NULL;
  if (jbLocal) {
    jbReset();
    jbLocal = false;
  }
}

int voipLocalBuffered() {
  return jbLocal ? jbCount() : 0;
}
